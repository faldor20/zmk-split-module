## boards/shields/eli/Kconfig.defconfig
```kconfig
# Copyright (c) 2020 The ZMK Contributors
# SPDX-License-Identifier: MIT

if SHIELD_ELI_RIGHT

config ZMK_KEYBOARD_NAME
    default "Eli"

config ZMK_SPLIT_ROLE_CENTRAL
    default y

endif

if SHIELD_ELI_LEFT || SHIELD_ELI_RIGHT 

config ZMK_SPLIT
    default y


endif

CONFIG_ZMK_SLEEP=y
```

## boards/shields/eli/Kconfig.shield
```kconfig
# Copyright (c) 2020 The ZMK Contributors
# SPDX-License-Identifier: MIT

config SHIELD_ELI_LEFT
    def_bool $(shields_list_contains,eli_left)

config SHIELD_ELI_RIGHT
    def_bool $(shields_list_contains,eli_right)
```
